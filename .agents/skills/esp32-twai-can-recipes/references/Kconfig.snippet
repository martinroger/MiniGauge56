## .agents/skills/esp32-twai-can-recipes/references/Kconfig.snippet
```kconfig
menu "TWAI / CAN Controller Configuration"

    config CAN_TX
        int "CAN Transmit (TX) GPIO Pin"
        default 2
        help
            GPIO pin connected to the CAN transceiver TX pin.
            Avoid strapping pins (GPIO 0, 3, 45, 46 on ESP32-S3).

    config CAN_RX
        int "CAN Receive (RX) GPIO Pin"
        default 3
        help
            GPIO pin connected to the CAN transceiver RX pin.

    config CAN_CORE_AFFINITY
        int "CAN RX Task Core Affinity"
        range 0 1
        default 1
        help
            CPU core for CAN RX interrupt worker task (Core 0 or Core 1).

    config CAN_BAUDRATE_500K
        bool "500 kbps Baud Rate"
        default y
        help
            Select standard 500 kbps high-speed CAN baud rate.

endmenu
```

## components/lcd_emulator/Kconfig
```kconfig
menu "Retro Monochrome LCD Emulator"

    choice LCD_EMULATOR_BOOT_RENDER_MODE
        prompt "Boot Render Mode"
        default LCD_EMULATOR_MODE_RETRO_MONOCHROME
        help
            Select the display rendering mode applied at boot.
            Can be toggled dynamically at runtime via lcd_emulator_set_render_mode().

        config LCD_EMULATOR_MODE_PASSTHROUGH
            bool "Passthrough (Modern Full-Color AMOLED)"

        config LCD_EMULATOR_MODE_RETRO_MONOCHROME
            bool "Retro Dot-Matrix LCD (Standard)"

        config LCD_EMULATOR_MODE_RETRO_INVERTED
            bool "Retro Dot-Matrix LCD (Inverted / Negative)"

        config LCD_EMULATOR_MODE_GRAYSCALE_4BIT
            bool "Retro Dot-Matrix LCD (4-bit Grayscale / 16 shades)"

        config LCD_EMULATOR_MODE_GRAYSCALE_8BIT
            bool "Retro Dot-Matrix LCD (8-bit Grayscale / 256 shades)"
    endchoice

    choice LCD_EMULATOR_GRAYSCALE_SHADING_STYLE
        prompt "Default Grayscale Shading Style"
        default LCD_EMULATOR_SHADING_PALETTE_TINTED
        help
            Select whether grayscale shading is tinted by the active palette (interpolating
            from inactive to active dot color) or renders as neutral monochrome gray.

        config LCD_EMULATOR_SHADING_PALETTE_TINTED
            bool "Palette-Tinted (Interpolates between inactive and active dot colors)"

        config LCD_EMULATOR_SHADING_NEUTRAL_GRAY
            bool "Neutral Gray (True monochrome R=G=B)"
    endchoice

    config LCD_EMULATOR_INVERT_OUTPUT
        bool "Invert LCD dot output polarity (Negative display)"
        default n
        help
            Invert the dot matrix state so that active elements become inactive and vice-versa.
            This produces a negative LCD / inverted display appearance.

    config LCD_EMULATOR_DARK_THEME_INPUT
        bool "Source UI has dark theme (AMOLED / black background with bright text)"
        default y
        help
            Enable if the source UI is designed for dark theme / AMOLED (black background,
            bright white/colored text and gauges). Bright elements become active LCD dots,
            and the black background becomes the inactive substrate. Disable if source UI
            has a white background with dark ink.

    config LCD_EMULATOR_DEFAULT_CELL_SIZE
        int "Default dot pitch (cell size in physical pixels)"
        default 4
        range 2 8
        help
            Physical pixel width and height of each simulated LCD dot matrix element.
            For example:
              - 3 pixels on a 466x466 screen corresponds to a 155x155 LCD matrix.
              - 4 pixels on a 466x466 screen corresponds to a 116x116 LCD matrix.

    config LCD_EMULATOR_DEFAULT_GAP_SIZE
        int "Default inactive gap width (pixels)"
        default 1
        range 0 3
        help
            Physical pixel gap between adjacent LCD dot elements simulating the inactive substrate grid.

    config LCD_EMULATOR_DEFAULT_THRESHOLD
        int "Default luminance threshold (0..255)"
        default 100
        range 0 255
        help
            Luminance threshold separating active LCD ink from the substrate.
            For anti-aliased fonts on AMOLED (dark theme), 90..120 gives crisp, legible strokes.

    choice LCD_EMULATOR_DEFAULT_PALETTE
        prompt "Default LCD Color Palette"
        default LCD_EMULATOR_PALETTE_OLIVE
        help
            Select the default color palette preset applied at boot.

        config LCD_EMULATOR_PALETTE_OLIVE
            bool "Classic Olive STN (Game Boy / Nokia 5110)"

        config LCD_EMULATOR_PALETTE_CASIO
            bool "Casio Reflective Grey / Silver"

        config LCD_EMULATOR_PALETTE_AMBER
            bool "Industrial Amber Backlit"

        config LCD_EMULATOR_PALETTE_CYAN
            bool "Nokia Cyan EL Backlit"

        config LCD_EMULATOR_PALETTE_CUSTOM
            bool "Custom (colors set manually below)"
    endchoice

    config LCD_EMULATOR_CUSTOM_COLOR_ON
        hex "Custom palette: ON (active dot) color, 0xRRGGBB"
        default 0xFFAA00
        range 0x000000 0xFFFFFF
        depends on LCD_EMULATOR_PALETTE_CUSTOM

    config LCD_EMULATOR_CUSTOM_COLOR_OFF
        hex "Custom palette: OFF (inactive dot) color, 0xRRGGBB"
        default 0x362104
        range 0x000000 0xFFFFFF
        depends on LCD_EMULATOR_PALETTE_CUSTOM

    config LCD_EMULATOR_CUSTOM_COLOR_GAP
        hex "Custom palette: GAP (grid line between dots) color, 0xRRGGBB"
        default 0x0D0700
        range 0x000000 0xFFFFFF
        depends on LCD_EMULATOR_PALETTE_CUSTOM

    config LCD_EMULATOR_CUSTOM_COLOR_BG
        hex "Custom palette: substrate background color, 0xRRGGBB"
        default 0x181002
        range 0x000000 0xFFFFFF
        depends on LCD_EMULATOR_PALETTE_CUSTOM

    choice LCD_EMULATOR_ALT_PALETTE
        prompt "Alternate LCD Color Palette (for lcd_emulator_swap_palette)"
        default LCD_EMULATOR_ALT_PALETTE_CASIO
        help
            Palette stored in the alternate slot at boot. lcd_emulator_swap_palette() flips
            between the default palette and this one; both slots can be redefined at runtime.

        config LCD_EMULATOR_ALT_PALETTE_OLIVE
            bool "Classic Olive STN"
        config LCD_EMULATOR_ALT_PALETTE_CASIO
            bool "Casio Reflective Grey / Silver"
        config LCD_EMULATOR_ALT_PALETTE_AMBER
            bool "Industrial Amber Backlit"
        config LCD_EMULATOR_ALT_PALETTE_CYAN
            bool "Nokia Cyan EL Backlit"
    endchoice

    config LCD_EMULATOR_EXPAND_TO_RGB565
        bool "Expand 8-bit framebuffer to 16-bit RGB565 for display hardware"
        default y if LV_COLOR_DEPTH_8
        default n
        help
            When LV_COLOR_DEPTH is 8 (L8 grayscale), LVGL renders in an 8-bit draw buffer.
            If the physical display controller (e.g. CO5300 AMOLED) requires 16-bit RGB565,
            enable this option to expand the 8-bit buffer to RGB565 before forwarding
            to the original display flush callback.

    config LCD_EMULATOR_STAGING_INTERNAL
        bool "Stage RGB565 output in an internal DMA-capable tile buffer"
        default y
        depends on LCD_EMULATOR_EXPAND_TO_RGB565
        help
            Allocate the RGB565 output buffer in internal DMA-capable RAM, sized to the largest
            tile the LVGL draw buffer holds, instead of a full-frame PSRAM buffer. Tiles larger
            than the staging buffer fall back to a lazily allocated PSRAM buffer.

    config LCD_EMULATOR_PROFILE
        bool "Enable flush-path profiling (1 Hz ESP_LOGI report)"
        default n
        help
            Accumulates cycle-counter timings for the decorate step, the wrapped display flush
            callback and the LVGL flush-finish latency, and logs tiles/s, pixels/s, us/tile,
            us/Mpixel, effective fps, LVGL task stack high-water mark and internal heap once per
            second. Compiled out entirely when disabled.

    # Backward compatibility alias
    config LCD_EMULATOR_ENABLE_AT_BOOT
        bool
        default y if !LCD_EMULATOR_MODE_PASSTHROUGH
        default n if LCD_EMULATOR_MODE_PASSTHROUGH

endmenu
```

## components/racebox_ble/Kconfig
```kconfig
menu "RaceBox BLE Configuration"

    config RACEBOX_BLE_TARGET_NAME_PREFIX
        string "Advertised Device Name Prefix"
        default "RaceBox "
        help
            Prefix of the BLE device name advertised by the receiver.
            Matches "RaceBox Mini ", "RaceBox Mini S ", or "RaceBox Micro ".

    config RACEBOX_BLE_SINGLE_TARGET_MODE
        bool "Enable Single Target Bond Mode"
        default n
        help
            When enabled, the central only connects to a specific locked RaceBox
            device rather than any discovered RaceBox.

    choice RACEBOX_BLE_TARGET_LOCK_TYPE
        prompt "Single Target Lock Mechanism"
        depends on RACEBOX_BLE_SINGLE_TARGET_MODE
        default RACEBOX_BLE_LOCK_BY_SERIAL
        help
            Method used to identify and verify the target RaceBox device.

        config RACEBOX_BLE_LOCK_BY_SERIAL
            bool "Lock by 10-digit Serial Number"
            help
                Matches the 10-digit serial number in the device name (e.g. "1234567890").

        config RACEBOX_BLE_LOCK_BY_MAC
            bool "Lock by Bluetooth MAC Address"
            help
                Matches the 6-byte Bluetooth device address.
    endchoice

    config RACEBOX_BLE_LOCKED_SERIAL
        string "Locked RaceBox Serial Number"
        depends on RACEBOX_BLE_LOCK_BY_SERIAL
        default ""
        help
            10-digit serial number of the designated RaceBox device.

    config RACEBOX_BLE_LOCKED_MAC
        string "Locked Bluetooth MAC Address"
        depends on RACEBOX_BLE_LOCK_BY_MAC
        default "00:00:00:00:00:00"
        help
            Target BLE MAC address in xx:xx:xx:xx:xx:xx format.

    config RACEBOX_BLE_PREFERRED_MTU
        int "Preferred GATT MTU Size (bytes)"
        default 512
        range 23 512
        help
            GATT Maximum Transmission Unit requested during connection.

    config RACEBOX_BLE_CONN_ITVL_MIN
        int "Minimum Connection Interval (in 1.25 ms units)"
        default 6
        range 6 3200
        help
            Minimum connection interval (6 = 7.5 ms).

    config RACEBOX_BLE_CONN_ITVL_MAX
        int "Maximum Connection Interval (in 1.25 ms units)"
        default 12
        range 6 3200
        help
            Maximum connection interval (12 = 15 ms).

endmenu
```

## components/racebox_twai/Kconfig
```kconfig
menu "RaceBox CAN / TWAI Configuration"

    config RACEBOX_CAN_BASE_ID
        hex "CAN Base ID for RaceBox Telemetry (Standard 11-bit)"
        default 0x600
        range 0x000 0x7F8
        help
            Base 11-bit CAN identifier for RaceBox frames.
            Messages occupy [BASE_ID + 0] through [BASE_ID + 5].
            Default 0x600 ensures low arbitration priority.

    config RACEBOX_TWAI_STATS_ENABLE
        bool "Enable CAN bus transmission statistics"
        default y
        help
            Enable tracking of CAN transmission metrics in racebox_twai:
            frames sent per message ID, transmit failure counts, queue depth,
            peak queue watermark, frames per second (FPS), and estimated
            bus load percentage.
            Disabling this reduces CPU overhead in the transmission path
            when diagnostic statistics are not needed.

    choice RACEBOX_CAN_RATE_SPEED_HEADING
        prompt "Message 0x600 (Speed & Heading) Broadcast Rate"
        default RACEBOX_CAN_RATE_SPEED_HEADING_25HZ
        help
            Transmission frequency for RB_SPEED_HEADING message.

        config RACEBOX_CAN_RATE_SPEED_HEADING_25HZ
            bool "25 Hz (Every frame)"
        config RACEBOX_CAN_RATE_SPEED_HEADING_10HZ
            bool "10 Hz"
        config RACEBOX_CAN_RATE_SPEED_HEADING_5HZ
            bool "5 Hz"
        config RACEBOX_CAN_RATE_SPEED_HEADING_1HZ
            bool "1 Hz"
        config RACEBOX_CAN_RATE_SPEED_HEADING_OFF
            bool "Disabled"
    endchoice

    choice RACEBOX_CAN_RATE_LAT_LON
        prompt "Message 0x601 (Coordinates Lat/Lon) Broadcast Rate"
        default RACEBOX_CAN_RATE_LAT_LON_25HZ
        help
            Transmission frequency for RB_LAT_LON message.

        config RACEBOX_CAN_RATE_LAT_LON_25HZ
            bool "25 Hz (Every frame)"
        config RACEBOX_CAN_RATE_LAT_LON_10HZ
            bool "10 Hz"
        config RACEBOX_CAN_RATE_LAT_LON_5HZ
            bool "5 Hz"
        config RACEBOX_CAN_RATE_LAT_LON_1HZ
            bool "1 Hz"
        config RACEBOX_CAN_RATE_LAT_LON_OFF
            bool "Disabled"
    endchoice

    choice RACEBOX_CAN_RATE_ALT_ACCURACY
        prompt "Message 0x602 (Altitude & Accuracy) Broadcast Rate"
        default RACEBOX_CAN_RATE_ALT_ACCURACY_25HZ
        help
            Transmission frequency for RB_ALT_ACCURACY message.

        config RACEBOX_CAN_RATE_ALT_ACCURACY_25HZ
            bool "25 Hz (Every frame)"
        config RACEBOX_CAN_RATE_ALT_ACCURACY_10HZ
            bool "10 Hz"
        config RACEBOX_CAN_RATE_ALT_ACCURACY_5HZ
            bool "5 Hz"
        config RACEBOX_CAN_RATE_ALT_ACCURACY_1HZ
            bool "1 Hz"
        config RACEBOX_CAN_RATE_ALT_ACCURACY_OFF
            bool "Disabled"
    endchoice

    choice RACEBOX_CAN_RATE_IMU_ACCEL
        prompt "Message 0x603 (IMU Accelerometer) Broadcast Rate"
        default RACEBOX_CAN_RATE_IMU_ACCEL_25HZ
        help
            Transmission frequency for RB_IMU_ACCEL message.

        config RACEBOX_CAN_RATE_IMU_ACCEL_25HZ
            bool "25 Hz (Every frame)"
        config RACEBOX_CAN_RATE_IMU_ACCEL_10HZ
            bool "10 Hz"
        config RACEBOX_CAN_RATE_IMU_ACCEL_5HZ
            bool "5 Hz"
        config RACEBOX_CAN_RATE_IMU_ACCEL_1HZ
            bool "1 Hz"
        config RACEBOX_CAN_RATE_IMU_ACCEL_OFF
            bool "Disabled"
    endchoice

    choice RACEBOX_CAN_RATE_IMU_GYRO
        prompt "Message 0x604 (IMU Gyroscope) Broadcast Rate"
        default RACEBOX_CAN_RATE_IMU_GYRO_25HZ
        help
            Transmission frequency for RB_IMU_GYRO message.

        config RACEBOX_CAN_RATE_IMU_GYRO_25HZ
            bool "25 Hz (Every frame)"
        config RACEBOX_CAN_RATE_IMU_GYRO_10HZ
            bool "10 Hz"
        config RACEBOX_CAN_RATE_IMU_GYRO_5HZ
            bool "5 Hz"
        config RACEBOX_CAN_RATE_IMU_GYRO_1HZ
            bool "1 Hz"
        config RACEBOX_CAN_RATE_IMU_GYRO_OFF
            bool "Disabled"
    endchoice

    choice RACEBOX_CAN_RATE_UTC_TIME
        prompt "Message 0x605 (UTC Date & Time) Broadcast Rate"
        default RACEBOX_CAN_RATE_UTC_TIME_25HZ
        help
            Transmission frequency for RB_UTC_TIME message.

        config RACEBOX_CAN_RATE_UTC_TIME_25HZ
            bool "25 Hz (Every frame)"
        config RACEBOX_CAN_RATE_UTC_TIME_10HZ
            bool "10 Hz"
        config RACEBOX_CAN_RATE_UTC_TIME_5HZ
            bool "5 Hz"
        config RACEBOX_CAN_RATE_UTC_TIME_1HZ
            bool "1 Hz"
        config RACEBOX_CAN_RATE_UTC_TIME_OFF
            bool "Disabled"
    endchoice

endmenu
```

## components/twai_daemon/Kconfig
```kconfig
menu "TWAI Daemon"
    config CAN_TX
        int "CAN Transceiver TX GPIO"
        default 39

    config CAN_RX
        int "CAN Transceiver RX GPIO"
        default 38

    config CAN_TX_POLLING_RATE_MS
        int "TX Queue polling interval in ms"
        default 5 

    config CAN_RX_TIMEOUT_MS
        int "RX Timeout in milliseconds"
        default 3000 

    config CAN_CORE_AFFINITY
        int "Core affinity for the TWAI daemon"
        default 1
endmenu
```
